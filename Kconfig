## Kconfig
```kconfig
config ZMK_BEHAVIOR_OLED_TOGGLE
    bool "OLED toggle behavior"
    default y
    depends on ZMK_DISPLAY
    help
      Adds keymap behaviors that blank or restore the display on a selected
      half of a split keyboard.
```

## config/west.yml
```yaml
manifest:
  remotes:
    - name: zmkfirmware
      url-base: https://github.com/zmkfirmware
    - name: mctechnology17
      url-base: https://github.com/mctechnology17
    - name: urob
      url-base: https://github.com/urob
  projects:
    - name: zmk
      remote: zmkfirmware
      revision: v0.3.0
      import: app/west.yml
    - name: zmk-nice-oled
      remote: mctechnology17
      revision: main
    - name: zmk-helpers
      remote: urob
      revision: v0.3
  self:
    path: config
```

## dts/bindings/behaviors/zmk,behavior-oled-toggle.yaml
```yaml
description: Toggle the OLED display on a selected half of a split keyboard

compatible: "zmk,behavior-oled-toggle"

include: zero_param.yaml

properties:
  central-target:
    type: boolean
    description: Target the central half instead of a peripheral half.
```
